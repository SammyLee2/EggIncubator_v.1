#define TOTAL_DAYS 21

#include <string.h>
#include <stdio.h>
#include "ssd1306.h"
#include "ssd1306_tests.h"
#include "ssd1306_fonts.h"


time_info_egg_incubator incubator_info;
static int updateDue = 0;



//------------------------------------------------------------------------------
// Table generated by LCD Assistant
// http://en.radzio.dxp.pl/bitmap_converter/
//------------------------------------------------------------------------------
const unsigned char egg_centre_63x64 [] = {
		0xff, 0xff, 0xff, 0xff, 0xff, 0xff, 0xff, 0xfe, 0xff, 0xff, 0xff, 0xff, 0xff, 0xff, 0xff, 0xfe,
		0xff, 0xff, 0xff, 0xff, 0xff, 0xff, 0xff, 0xfe, 0xff, 0xff, 0xff, 0xff, 0xff, 0xff, 0xff, 0xfe,
		0xff, 0xff, 0xff, 0xff, 0xff, 0xff, 0xff, 0xfe, 0xff, 0xff, 0xff, 0xff, 0xff, 0xff, 0xff, 0xfe,
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		0xff, 0xff, 0xff, 0xff, 0xff, 0xff, 0xff, 0xfe, 0xff, 0xff, 0xff, 0xff, 0xff, 0xff, 0xff, 0xfe
};
const unsigned char egg_tilt_left1_49x64 []  = {
	0xff, 0xff, 0xff, 0xff, 0xff, 0xff, 0x80, 0xff, 0xff, 0xff, 0xff, 0xff, 0xff, 0x80, 0xff, 0xff,
	0xff, 0xff, 0xff, 0xff, 0x80, 0xff, 0xff, 0xff, 0xff, 0xff, 0xff, 0x80, 0xff, 0xff, 0xff, 0xff,
	0xff, 0xff, 0x80, 0xff, 0xff, 0xff, 0xff, 0xff, 0xff, 0x80, 0xff, 0xff, 0xff, 0xff, 0xff, 0xff,
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	0xff, 0x80, 0xff, 0xff, 0xff, 0xff, 0xff, 0xff, 0x80, 0xff, 0xff, 0xff, 0xff, 0xff, 0xff, 0x80
};

const unsigned char egg_tilt_left2_57x64 [] = {
	0xff, 0xff, 0xff, 0xff, 0xff, 0xff, 0xff, 0x80, 0xff, 0xff, 0xff, 0xff, 0xff, 0xff, 0xff, 0x80,
	0xff, 0xff, 0xff, 0xff, 0xff, 0xff, 0xff, 0x80, 0xff, 0xff, 0xff, 0xff, 0xff, 0xff, 0xff, 0x80,
	0xff, 0xff, 0xff, 0xff, 0xff, 0xff, 0xff, 0x80, 0xff, 0xff, 0xff, 0xff, 0xff, 0xff, 0xff, 0x80,
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	0xff, 0xff, 0xff, 0xff, 0xff, 0xff, 0xff, 0x80, 0xff, 0xff, 0xff, 0xff, 0xff, 0xff, 0xff, 0x80
};

const unsigned char egg_tilt_right1_53x64 [] = {
	0xff, 0xff, 0xff, 0xff, 0xff, 0xff, 0xf8, 0xff, 0xff, 0xff, 0xff, 0xff, 0xff, 0xf8, 0xff, 0xff,
	0xff, 0xff, 0xff, 0xff, 0xf8, 0xff, 0xff, 0xff, 0xff, 0xff, 0xff, 0xf8, 0xff, 0xff, 0xff, 0x83,
	0xff, 0xff, 0xf8, 0xff, 0xff, 0xfe, 0x00, 0x7f, 0xff, 0xf8, 0xff, 0xff, 0xf8, 0x7e, 0x3f, 0xff,
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	0xff, 0xf8, 0xff, 0xff, 0xff, 0xff, 0xff, 0xff, 0xf8, 0xff, 0xff, 0xff, 0xff, 0xff, 0xff, 0xf8
};

const unsigned char egg_tilt_right2_48x64 [] = {
	0xff, 0xff, 0xff, 0xff, 0xff, 0xff, 0xff, 0xff, 0xff, 0xff, 0xff, 0xff, 0xff, 0xff, 0xff, 0xff,
	0xff, 0xff, 0xff, 0xff, 0xff, 0xff, 0xff, 0xff, 0xff, 0xff, 0xff, 0xff, 0xff, 0xff, 0xff, 0xff,
	0xff, 0xff, 0xff, 0xff, 0xff, 0xff, 0xff, 0xff, 0xff, 0xff, 0xff, 0xff, 0xff, 0xc3, 0xff, 0xff,
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	0xff, 0xff, 0xff, 0xff, 0xff, 0xff, 0xff, 0xff, 0xff, 0xff, 0xff, 0xff, 0xff, 0xff, 0xff, 0xff
};



const unsigned char egg_hatching_128x64 []  = {
	0xff, 0xff, 0xff, 0xfd, 0xf8, 0x7f, 0xe1, 0xff, 0xff, 0xff, 0xff, 0xff, 0xff, 0xff, 0xff, 0xff,
	0xff, 0xff, 0xff, 0xfe, 0xff, 0xff, 0xfc, 0x7f, 0xff, 0xff, 0xff, 0xff, 0xff, 0xff, 0xff, 0xff,
	0xff, 0xff, 0xff, 0xfe, 0x7f, 0xff, 0xff, 0x3f, 0xff, 0xff, 0xff, 0xff, 0xff, 0xff, 0xff, 0xff,
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	0xff, 0xff, 0xff, 0xff, 0xff, 0xff, 0xff, 0xf8, 0xfd, 0xff, 0x9f, 0xff, 0xff, 0xf9, 0xff, 0xff
};


const unsigned char garfield_128x64 [] = {
0x00, 0x00, 0x00, 0x00, 0x00, 0x00, 0x00, 0x00, 0x00, 0x00, 0x00, 0x00, 0x00, 0x00, 0x00, 0x00,
0x00, 0x00, 0x00, 0x00, 0x00, 0x07, 0xFF, 0x00, 0x00, 0x00, 0x00, 0x00, 0x00, 0x00, 0x00, 0x00,
0x00, 0x00, 0x00, 0x00, 0x00, 0x1F, 0xFF, 0xF8, 0x7F, 0xE0, 0x00, 0x00, 0x00, 0x00, 0x00, 0x00,
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0x00, 0x00, 0x00, 0x00, 0x00, 0x03, 0xFF, 0xE0, 0xC0, 0x3F, 0x9E, 0x00, 0x00, 0x00, 0x00, 0x00
};

const unsigned char github_logo_64x64[] = {
0x00, 0x00, 0x00, 0x1F, 0xF8, 0x00, 0x00, 0x00, 0x00, 0x00, 0x03, 0xFF, 0xFF, 0x80, 0x00, 0x00,
0x00, 0x00, 0x0F, 0xFF, 0xFF, 0xF0, 0x00, 0x00, 0x00, 0x00, 0x3F, 0xFF, 0xFF, 0xFC, 0x00, 0x00,
0x00, 0x00, 0xFF, 0xFF, 0xFF, 0xFF, 0x00, 0x00, 0x00, 0x03, 0xFF, 0xFF, 0xFF, 0xFF, 0xC0, 0x00,
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0x00, 0x00, 0x00, 0x00, 0x00, 0x00, 0x00, 0x00, 0x00, 0x00, 0x00, 0x00, 0x00, 0x00, 0x00, 0x00
};

void ssd1306_TestBorder() {
    ssd1306_Fill(Black);
   
    uint8_t x = 0;
    uint8_t y = 0;
    do {
        ssd1306_DrawPixel(x, y, Black);

        if((y == 0) && (x < (SSD1306_WIDTH-1)))
            x++;
        else if((x == (SSD1306_WIDTH-1)) && (y < (SSD1306_HEIGHT-1)))
            y++;
        else if((y == (SSD1306_HEIGHT-1)) && (x > 0)) 
            x--;
        else
            y--;

        ssd1306_DrawPixel(x, y, White);
        ssd1306_UpdateScreen();
    
        HAL_Delay(5);
    } while(x > 0 || y > 0);
   
    HAL_Delay(1000);
}

void ssd1306_TestFonts1() {
    uint8_t y = 0;
    ssd1306_Fill(Black);

    #ifdef SSD1306_INCLUDE_FONT_16x26
    ssd1306_SetCursor(2, y);
    ssd1306_WriteString("Font 16x26", Font_16x26, White);
    y += 26;
    #endif

    #ifdef SSD1306_INCLUDE_FONT_11x18
    ssd1306_SetCursor(2, y);
    ssd1306_WriteString("Font 11x18", Font_11x18, White);
    y += 18;
    #endif

    #ifdef SSD1306_INCLUDE_FONT_7x10
    ssd1306_SetCursor(2, y);
    ssd1306_WriteString("Font 7x10", Font_7x10, White);
    y += 10;
    #endif

    #ifdef SSD1306_INCLUDE_FONT_6x8
    ssd1306_SetCursor(2, y);
    ssd1306_WriteString("Font 6x8", Font_6x8, White);
    #endif

    ssd1306_UpdateScreen();
}

/*
 * This test shows how an 128x64 px OLED can replace a 0802 LCD.
 */
void ssd1306_TestFonts2() {
#ifdef SSD1306_INCLUDE_FONT_16x24
    uint8_t x1, y1, x2, y2;

    ssd1306_Fill(Black);

    ssd1306_SetCursor(0, 4);
    ssd1306_WriteString("18.092.5", Font_16x24, White);
    ssd1306_SetCursor(0, 4+24+8);
    ssd1306_WriteString("RIT+1000", Font_16x24, White);

    // underline
    x1 = 6*16;
    y1 = 4+24+8+24;
    x2 = x1+16;
    y2 = y1+2;
    ssd1306_FillRectangle(x1, y1, x2, y2, White);

    ssd1306_UpdateScreen();
#endif
}

/*
 * Test of proportional (non-monospaced) font.
 */
void ssd1306_TestFonts3() {
    ssd1306_Fill(Black);
#ifdef SSD1306_INCLUDE_FONT_16x15
    ssd1306_SetCursor(4, 4);
    ssd1306_WriteString("Proportional", Font_16x15, White);
    ssd1306_SetCursor(4, 24);
    ssd1306_WriteString("text... Sweet!", Font_16x15, White);
    ssd1306_SetCursor(4, 44);
    ssd1306_WriteString("3.1415  04:20", Font_16x15, White);
#elif defined(SSD1306_INCLUDE_FONT_11x18)
    ssd1306_SetCursor(4, 4);
    ssd1306_WriteString("Skip test", Font_11x18, White);
    ssd1306_SetCursor(4, 24);
    ssd1306_WriteString("Font not", Font_11x18, White);
    ssd1306_SetCursor(4, 44);
    ssd1306_WriteString("included!", Font_11x18, White);
#endif
    ssd1306_UpdateScreen();
}

void ssd1306_TestFPS() {
    ssd1306_Fill(White);
   
    uint32_t start = HAL_GetTick();
    uint32_t end = start;
    int fps = 0;
    char message[] = "ABCDEFGHIJK";
   
    ssd1306_SetCursor(2,0);
    ssd1306_WriteString("Testing...", Font_11x18, Black);
    ssd1306_SetCursor(2, 18*2);
    ssd1306_WriteString("0123456789A", Font_11x18, Black);
   
    do {
        ssd1306_SetCursor(2, 18);
        ssd1306_WriteString(message, Font_11x18, Black);
        ssd1306_UpdateScreen();
       
        char ch = message[0];
        memmove(message, message+1, sizeof(message)-2);
        message[sizeof(message)-2] = ch;

        fps++;
        end = HAL_GetTick();
    } while((end - start) < 5000);
   
    HAL_Delay(5000);

    char buff[64];
    fps = (float)fps / ((end - start) / 1000.0);
    snprintf(buff, sizeof(buff), "~%d FPS", fps);
   
    ssd1306_Fill(White);
    ssd1306_SetCursor(2, 2);
    ssd1306_WriteString(buff, Font_11x18, Black);
    ssd1306_UpdateScreen();
}

void ssd1306_TestLine() {

  ssd1306_Line(1,1,SSD1306_WIDTH - 1,SSD1306_HEIGHT - 1,White);
  ssd1306_Line(SSD1306_WIDTH - 1,1,1,SSD1306_HEIGHT - 1,White);
  ssd1306_UpdateScreen();
  return;
}

void ssd1306_TestRectangle() {
  uint32_t delta;

  for(delta = 0; delta < 5; delta ++) {
    ssd1306_DrawRectangle(1 + (5*delta),1 + (5*delta) ,SSD1306_WIDTH-1 - (5*delta),SSD1306_HEIGHT-1 - (5*delta),White);
  }
  ssd1306_UpdateScreen();
  return;
}

void ssd1306_TestRectangleFill() {
  ssd1306_FillRectangle(31, 1, 65, 35, White);
  ssd1306_FillRectangle(10, 45, 70, 60, White);
  ssd1306_FillRectangle(75, 10, 100, 45, White);
  ssd1306_FillRectangle(55, 30, 80, 55, Black);
  ssd1306_UpdateScreen();
}

void ssd1306_TestRectangleInvert() {
#ifdef SSD1306_INCLUDE_FONT_11x18
  ssd1306_SetCursor(2, 0);
  ssd1306_WriteString("Black", Font_11x18, White);
  ssd1306_SetCursor(2, 20);
  ssd1306_WriteString("on", Font_11x18, White);
  ssd1306_SetCursor(2, 40);
  ssd1306_WriteString("White", Font_11x18, White);
  ssd1306_SetCursor(66, 0);
  ssd1306_WriteString("White", Font_11x18, White);
  ssd1306_SetCursor(66, 20);
  ssd1306_WriteString("on", Font_11x18, White);
  ssd1306_SetCursor(66, 40);
  ssd1306_WriteString("Black", Font_11x18, White);
#else
  ssd1306_FillCircle(32, 32, 20, White);
  ssd1306_FillCircle(96, 32, 20, White);
#endif
  ssd1306_InvertRectangle(0,0,63,63);
  /* Test rectangle lies on one 8px page */
  ssd1306_InvertRectangle(2,58,125,60);
  ssd1306_UpdateScreen();
}

void ssd1306_TestCircle() {
  uint32_t delta;

  for(delta = 0; delta < 5; delta ++) {
    ssd1306_DrawCircle(20*delta+30, 15, 10, White);
  }

  for(delta = 0; delta < 5; delta ++) {
    ssd1306_FillCircle(23*delta+15, 40, 10, White);
  }

  ssd1306_UpdateScreen();
  return;
}

void ssd1306_TestArc() {
  ssd1306_DrawArc(30, 30, 30, 20, 270, White);
  ssd1306_DrawArcWithRadiusLine(80, 55, 10, 30, 270, White);
  ssd1306_UpdateScreen();
  return;
}

void ssd1306_TestPolyline() {
  SSD1306_VERTEX loc_vertex[] =
  {
      {35,40},
      {40,20},
      {45,28},
      {50,10},
      {45,16},
      {50,10},
      {53,16}
  };

  ssd1306_Polyline(loc_vertex,sizeof(loc_vertex)/sizeof(loc_vertex[0]),White);
  ssd1306_UpdateScreen();
  return;
}

void ssd1306_TestDrawBitmap()
{
    /*ssd1306_Fill(White);
    ssd1306_DrawBitmap(0,0,garfield_128x64,128,64,Black);
    ssd1306_UpdateScreen();
    HAL_Delay(3000);
    ssd1306_Fill(Black);
    ssd1306_DrawBitmap(32,0,github_logo_64x64,64,64,White);
    ssd1306_UpdateScreen();
    HAL_Delay(3000);
    ssd1306_Fill(White);
    ssd1306_DrawBitmap(32,0,github_logo_64x64,64,64,Black);
    ssd1306_UpdateScreen();
    */



    //testing egg hatching bitmap





}
void ssd1306_TestAll() {
/*    ssd1306_Init();

    ssd1306_TestFPS();
    HAL_Delay(3000);
    ssd1306_TestBorder();
    ssd1306_TestFonts1();
    HAL_Delay(3000);
    ssd1306_TestFonts2();
    HAL_Delay(3000);
    ssd1306_TestFonts3();
    //
    HAL_Delay(3000);
    ssd1306_Fill(Black);
    ssd1306_TestRectangle();
    ssd1306_TestLine();
    HAL_Delay(3000);
    ssd1306_Fill(Black);
    ssd1306_TestRectangleFill();
    HAL_Delay(3000);
    ssd1306_Fill(Black);
    ssd1306_TestRectangleInvert();
    HAL_Delay(3000);
    ssd1306_Fill(Black);
    ssd1306_TestPolyline();
    HAL_Delay(3000);
    ssd1306_Fill(Black);
    ssd1306_TestArc();
    HAL_Delay(3000);
    ssd1306_Fill(Black);
    ssd1306_TestCircle();
    HAL_Delay(3000);
    ssd1306_TestDrawBitmap();
    HAL_Delay(3000);
*/
}



void ssd1306_draw_egg_shaking(){
	//egg standing still
    ssd1306_Fill(Black);
    ssd1306_DrawBitmap(32,0,egg_centre_63x64,63,64,White);
    ssd1306_UpdateScreen();
    HAL_Delay(1000);

    //Egg shaking starts
    ssd1306_Fill(Black);
    ssd1306_DrawBitmap(39,0,egg_tilt_left1_49x64,49,64,White);
    ssd1306_UpdateScreen();
    HAL_Delay(200);

    ssd1306_Fill(Black);
    ssd1306_DrawBitmap(35,0,egg_tilt_left2_57x64,57,64,White);
    ssd1306_UpdateScreen();
    HAL_Delay(200);

    ssd1306_Fill(Black);
    ssd1306_DrawBitmap(32,0,egg_centre_63x64,63,64,White);
    ssd1306_UpdateScreen();
    HAL_Delay(200);

    ssd1306_Fill(Black);
    ssd1306_DrawBitmap(37,0,egg_tilt_right1_53x64,53,64,White);
    ssd1306_UpdateScreen();
    HAL_Delay(200);

    ssd1306_Fill(Black);
    ssd1306_DrawBitmap(40,0,egg_tilt_right2_48x64,48,64,White);
    ssd1306_UpdateScreen();
    HAL_Delay(200);

    ssd1306_Fill(Black);
    ssd1306_DrawBitmap(37,0,egg_tilt_right1_53x64,53,64,White);
    ssd1306_UpdateScreen();
    HAL_Delay(200);

    //egg standing still
    ssd1306_Fill(Black);
    ssd1306_DrawBitmap(32,0,egg_centre_63x64 ,63,64,White);
    ssd1306_UpdateScreen();
    HAL_Delay(1000);

}

void ssd1306_draw_egg_breaking(){
    //egg breaking
    int x = 44;
    int y = 30;
    int crack_height = 0;
    int direction = 1;
    int buffer = 0;

    ssd1306_SetCursor(35, 55);
    ssd1306_WriteString("Hatching..", Font_6x8, Black);
    ssd1306_UpdateScreen();


    //draw from 44 < x < 84

    //draw from 30 < y < 33
    // to make y fluctuate from 30~33, use an equation y = y + buffer+ crack_height*direction
    // Y must be going from 30 to 33, and come back to 30 again and repeat. (30 - 31 - 32 - 33 - 32 - 31 - 30 * n times)

    while(x<84){
        ssd1306_DrawPixel(x, y + buffer+ crack_height*direction, Black);
        ssd1306_UpdateScreen();
        HAL_Delay(50);

        x++;
        crack_height++;
        if(crack_height ==4){
        	crack_height =0;

        	if(direction ==1){
        		direction =-1;
        		buffer =3;
        	}
        	else{
        		direction =1;
        		buffer =0;
        	}

        }




    }

}

void ssd1306_draw_egg_hatching(){
    HAL_Delay(3000);
    ssd1306_Fill(Black);
    ssd1306_DrawBitmap(0,0,egg_hatching_128x64,128,64,White);

    ssd1306_SetCursor(0, 45);
    ssd1306_WriteString("Your little ones' ", Font_6x8, Black);
    ssd1306_SetCursor(45, 55);
    ssd1306_WriteString("best start", Font_6x8, Black);



    ssd1306_UpdateScreen();

    ssd1306_UpdateScreen();



}

void ssd1306_egg_incubator_booting(){
	ssd1306_Init();
	ssd1306_draw_egg_shaking();
	ssd1306_draw_egg_shaking();
	ssd1306_draw_egg_breaking();
	ssd1306_draw_egg_hatching();
	HAL_Delay(2000);
}

void ssd1306_show_egg_incubator_state_first_page(char* status, float temperature, int heater_state){

    char buffer[32]; // 충분한 크기의 버퍼 선언

	ssd1306_Fill(Black);
    ssd1306_SetCursor(30, 4);
    ssd1306_WriteString("Egg Incubator", Font_6x8, White);
    ssd1306_SetCursor(4, 14);
    ssd1306_WriteString(" ---------------------", Font_6x8, White);

    ssd1306_SetCursor(4, 24);
    ssd1306_WriteString("Current Status:  ", Font_6x8, White);

    ssd1306_SetCursor(4, 34);
    sprintf(buffer, "%s", status);
    ssd1306_WriteString(buffer, Font_6x8, White);

    ssd1306_SetCursor(4, 44);
    sprintf(buffer, "Temperature: %.1f C", temperature);
    ssd1306_WriteString(buffer, Font_6x8, White);

    ssd1306_SetCursor(4, 54);

    if(heater_state){
        sprintf(buffer, "Heater: %s", "On");
        ssd1306_WriteString(buffer, Font_6x8, White);
    }else{
        sprintf(buffer, "Heater: %s", "Off");
        ssd1306_WriteString(buffer, Font_6x8, White);

    }




    ssd1306_UpdateScreen();
    HAL_Delay(4000);

}

void ssd1306_show_egg_incubator_state_second_page(){
	//calculate_time();
	char buffer[32];
	ssd1306_Fill(Black);
    ssd1306_SetCursor(4, 4);
    sprintf(buffer, "Progress: %lu %%", incubator_info.progress);
    ssd1306_WriteString(buffer, Font_6x8, White);

    ssd1306_SetCursor(4, 14);
    ssd1306_WriteString(" ---------------------", Font_6x8, White);

    ssd1306_SetCursor(4, 24);
    ssd1306_WriteString("Incubation Period: ", Font_6x8, White);

    ssd1306_SetCursor(4, 34);
    sprintf(buffer, "  %lu days %lu hours", incubator_info.elapsed_days, incubator_info.elapsed_hours);
    ssd1306_WriteString(buffer, Font_6x8, White);

    ssd1306_SetCursor(4, 44);
    ssd1306_WriteString("Time to Hatch:", Font_6x8, White);

    ssd1306_SetCursor(4, 54);
    sprintf(buffer, "  %lu days %lu hours", incubator_info.remaining_days, incubator_info.remaining_hours);
    ssd1306_WriteString(buffer, Font_6x8, White);

	ssd1306_UpdateScreen();
    HAL_Delay(4000);


}




void calculate_time(uint32_t *startTime) {
    // Reset if the program startup was not saved
    if (*startTime == 0) {
    	*startTime = HAL_GetTick()/1000;
    }

    uint32_t current_time = HAL_GetTick()/1000;
    // Calculate elapsed time (in seconds) from the start of the program
    uint32_t elapsed_seconds  = current_time - (*startTime);
    // Convert seconds to days and hours

    //1814400 = 21days * 24hours * 60minutes * 60seconds
    //if the status is preparing
    if (*startTime == 1814401) {
    	elapsed_seconds = 0;
    }
    //if the status is completed
    if (*startTime == 1814402) {
    	elapsed_seconds = 1814400;
    }


    uint32_t days_elapsed = elapsed_seconds / (60 * 60 * 24);
    uint32_t hours_elapsed = (int)((elapsed_seconds / (60 * 60)) - (days_elapsed * 24));

    incubator_info.elapsed_days = days_elapsed;
    incubator_info.elapsed_hours = hours_elapsed;

    // calculate remaining seconds
    uint32_t total_seconds = TOTAL_DAYS * 24 * 60 * 60;
    uint32_t remaining_seconds = total_seconds - elapsed_seconds;

    // Convert seconds to days and hours
    uint32_t days_left = remaining_seconds / (60 * 60 * 24);
    uint32_t hours_left = (uint32_t)((remaining_seconds / (60 * 60)) - (days_left * 24));
    incubator_info.remaining_days = days_left;
    incubator_info.remaining_hours = hours_left;

    // Progress Calculation
    uint32_t progress_percent = (elapsed_seconds * 100)/ total_seconds;
    incubator_info.progress = progress_percent;

}


void display_ssd1306(uint32_t *startTime, char *status, float temperature, int heater_state){
/*	if(updateDue==60||updateDue==0){
		calculate_time(startTime);
		updateDue =0;
	}*/
	calculate_time(startTime);



	ssd1306_show_egg_incubator_state_first_page(status, temperature, heater_state);
	ssd1306_show_egg_incubator_state_second_page();
	HAL_Delay(1000);
	updateDue++;
}



void ssd1306_show_egg_incubator_state_test_1(){
	ssd1306_Fill(Black);
    ssd1306_SetCursor(30, 4);
    ssd1306_WriteString("Egg Incubator", Font_6x8, White);
    ssd1306_SetCursor(4, 14);
    ssd1306_WriteString(" ---------------------", Font_6x8, White);

    ssd1306_SetCursor(4, 24);
    ssd1306_WriteString("Current Status:  ", Font_6x8, White);
    ssd1306_SetCursor(4, 34);
    ssd1306_WriteString("Incubating", Font_6x8, White);


    ssd1306_SetCursor(4, 44);
    ssd1306_WriteString("Temperature: 38.5C", Font_6x8, White);

    ssd1306_SetCursor(4, 54);
    ssd1306_WriteString("Heater: ON ", Font_6x8, White);

    ssd1306_UpdateScreen();
    HAL_Delay(2000);
    ssd1306_show_egg_incubator_state_test_2();

}

void ssd1306_show_egg_incubator_state_test_2(){
	ssd1306_Fill(Black);
    ssd1306_SetCursor(4, 4);
    ssd1306_WriteString("Progress: 71% ", Font_6x8, White);
    ssd1306_SetCursor(4, 14);
    ssd1306_WriteString(" ---------------------", Font_6x8, White);

    ssd1306_SetCursor(4, 24);
    ssd1306_WriteString("Incubation Period: ", Font_6x8, White);

    ssd1306_SetCursor(4, 34);
    ssd1306_WriteString("  15 days 3 hours", Font_6x8, White);

    ssd1306_SetCursor(4, 44);
    ssd1306_WriteString("Time to Hatch:", Font_6x8, White);

    ssd1306_SetCursor(4, 54);
    ssd1306_WriteString("  5 days 21 hours ", Font_6x8, White);

    //ssd1306_SetCursor(4, 54);
    //ssd1306_WriteString("Expected Hatch Day: May 10, 2024 ", Font_6x8, White);


    ssd1306_UpdateScreen();
}

void ssd1306_Preparig_transition(){
	ssd1306_Fill(Black);
    ssd1306_SetCursor(2, 0);
    ssd1306_WriteString("Preparing", Font_11x18, White);
    ssd1306_SetCursor(2, 30);
    ssd1306_WriteString("Incubating.", Font_11x18, White);
    ssd1306_UpdateScreen();
    //HAL_Delay(500);
}

void ssd1306_Incubating_transition(){
	ssd1306_Fill(Black);
    ssd1306_SetCursor(2, 0);
    ssd1306_WriteString("Start", Font_11x18, White);
    ssd1306_SetCursor(2, 30);
    ssd1306_WriteString("Incubating.", Font_11x18, White);
    ssd1306_UpdateScreen();
    //HAL_Delay(500);

}

void ssd1306_Completing_transition(){
	ssd1306_Fill(Black);
    ssd1306_SetCursor(2, 0);
    ssd1306_WriteString("Completing", Font_11x18, White);
    ssd1306_SetCursor(2, 30);
    ssd1306_WriteString("Incubating!", Font_11x18, White);
    ssd1306_UpdateScreen();
    //HAL_Delay(500);


}

